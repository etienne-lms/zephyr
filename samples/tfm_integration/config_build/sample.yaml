## samples/tfm_integration/config_build/sample.yaml
```yaml
sample:
  description: Test TF-M builds in various configurations
  name: TF-M build configuration
common:
  tags:
    - trusted-firmware-m
  platform_allow:
    - v2m_musca_s1/musca_s1/ns
    - nrf5340dk/nrf5340/cpuapp/ns
    - nrf9160dk/nrf9160/ns
    - nrf54l15dk/nrf54l15/cpuapp/ns
    - nrf54l15dk/nrf54l10/cpuapp/ns
    - nrf54lm20dk/nrf54lm20a/cpuapp/ns
    - nrf54lm20dk/nrf54lm20b/cpuapp/ns
    - nrf7120dk/nrf7120/cpuapp/ns
    - bl5340_dvk/nrf5340/cpuapp/ns
    - b_u585i_iot02a/stm32u585xx/ns
    - nucleo_l552ze_q/stm32l552xx/ns
    - nucleo_wba65ri/stm32wba65xx/ns
    - stm32l562e_dk/stm32l562xx/ns
    - stm32h573i_dk/stm32h573xx/ns
    - stm32wba65i_dk1/stm32wba65xx/ns
  integration_platforms:
    - nrf5340dk/nrf5340/cpuapp/ns
  harness: console
  harness_config:
    type: one_line
    regex:
      - "Hello World! (.*)"
tests:
  sample.config_build.no_bl2:
    extra_configs:
      - CONFIG_TFM_BL2=n
```

## samples/tfm_integration/tfm_psa_test/sample.yaml
```yaml
common:
  tags:
    - trusted-firmware-m
    - mcuboot
  platform_allow:
    - mps2/an521/cpu0/ns
    - nrf5340dk/nrf5340/cpuapp/ns
    - nrf9160dk/nrf9160/ns
    - nrf9161dk/nrf9161/ns
    - v2m_musca_s1/musca_s1/ns
    - frdm_mcxn947/mcxn947/cpu0/ns
    - b_u585i_iot02a/stm32u585xx/ns
    - nucleo_l552ze_q/stm32l552xx/ns
    - nucleo_wba65ri/stm32wba65xx/ns
    - stm32l562e_dk/stm32l562xx/ns
    - stm32h573i_dk/stm32h573xx/ns
    - stm32wba65i_dk1/stm32wba65xx/ns
  modules:
    - psa-arch-tests
  integration_platforms:
    - mps2/an521/cpu0/ns
  harness: console
  harness_config:
    type: multi_line
    regex:
      - "\\*\\*\\*\\*\\* PSA Architecture Test Suite - Version .* \\*\\*\\*\\*\\*"
      - "TOTAL FAILED *: 0"
sample:
  name: "TFM PSA Test"

tests:
  sample.tfm.psa_test_protected_storage:
    extra_args: "CONFIG_TFM_PSA_TEST_PROTECTED_STORAGE=y"
    timeout: 120
  sample.tfm.psa_test_internal_trusted_storage:
    extra_args: "CONFIG_TFM_PSA_TEST_INTERNAL_TRUSTED_STORAGE=y"
  sample.tfm.psa_test_storage:
    extra_args: "CONFIG_TFM_PSA_TEST_STORAGE=y"
    timeout: 130
  sample.tfm.psa_test_crypto:
    timeout: 120
    extra_args: "CONFIG_TFM_PSA_TEST_CRYPTO=y"
    platform_exclude:
    - stm32h573i_dk/stm32h573xx/ns   # requires patch in psa-arch-test EC192/224
    - nucleo_l552ze_q/stm32l552xx/ns # requires patch in psa-arch-test EC192/224, RSA1024
    - stm32l562e_dk/stm32l562xx/ns   # requires patch in psa-arch-test EC192/224, RSA1024
# The test suite below has been disabled due to licensing issues with the QCBOR
# library used by t_cose. This test will be re-enabled once the licensing
# issues have been sorted out upstream.
#
#  sample.tfm.psa_test_initial_attestation:
#    extra_args: "CONFIG_TFM_PSA_TEST_INITIAL_ATTESTATION=y"
```
